## meta-cirthfb/conf/layer.conf
```bitbake
BBPATH .= ":${LAYERDIR}"

BBFILES += "${LAYERDIR}/recipes-*/*/*.bb \
             ${LAYERDIR}/recipes-*/*/*.bbappend"

BBFILE_COLLECTIONS += "meta-cirthfb"
BBFILE_PATTERN_meta-cirthfb = "^${LAYERDIR}/"
BBFILE_PRIORITY_meta-cirthfb = "6"

LAYERDEPENDS_meta-cirthfb = "core raspberrypi"
LAYERSERIES_COMPAT_meta-cirthfb = "scarthgap"
```
